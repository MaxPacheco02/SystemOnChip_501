# file: SensorsData_Reto.ioc
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Mcu.Family=STM32F1
Mcu.Name=STM32F103R(8-B)Tx
Mcu.Package=LQFP64
NVIC.PriorityGroup=NVIC_PRIORITYGROUP_4
PA13.GPIO_Label=TMS
PA13.Mode=Serial_Wire
PA13.Signal=SYS_JTMS-SWDIO
PA14.GPIO_Label=TCK
PA14.Mode=Serial_Wire
PA14.Signal=SYS_JTCK-SWCLK
PB3.GPIO_Label=SWO
PB3.Signal=SYS_JTDO-TRACESWO
PC14-OSC32_IN.Mode=LSE-External-Oscillator
PC14-OSC32_IN.Signal=RCC_OSC32_IN
PC15-OSC32_OUT.Mode=LSE-External-Oscillator
PC15-OSC32_OUT.Signal=RCC_OSC32_OUT
PD0-OSC_IN.Mode=HSE-External-Clock-Source
PD0-OSC_IN.Signal=RCC_OSC_IN
PD1-OSC_OUT.Mode=HSE-External-Clock-Source
PD1-OSC_OUT.Signal=RCC_OSC_OUT
ProjectManager.HeapSize=0x200
ProjectManager.StackSize=0x400
ProjectManager.TargetToolchain=STM32CubeIDE
RCC.AHBFreq_Value=64000000
RCC.APB1CLKDivider=RCC_HCLK_DIV2
RCC.APB1Freq_Value=32000000
RCC.APB1TimFreq_Value=64000000
RCC.APB2Freq_Value=64000000
RCC.APB2TimFreq_Value=64000000
RCC.HCLKFreq_Value=64000000
RCC.PLLMUL=RCC_PLL_MUL16
RCC.RTCClockSelection=RCC_RTCCLKSOURCE_LSE
RCC.SYSCLKFreq_VALUE=64000000
RCC.SYSCLKSource=RCC_SYSCLKSOURCE_PLLCLK
RCC.USBFreq_Value=64000000
board=NUCLEO-F103RB

// file: Core/Src/main.c
/* USER CODE BEGIN Header */
/**
  ******************************************************************************
  * @file           : main.c
  * @author         : rahu7p
  * @co-author      : MaxPacheco02
  ******************************************************************************
  * @board	  : nucleo-f103rb
  * @mcu	  : stm32f103rb
  *
  *
  *
  * Used @rahu7p's template to solve the class' challenge
  *
  *
  ******************************************************************************
  */
/* USER CODE END Header */
#include "main.h"
#include "myprintf.h"
#include "lcd.h"
#include <stdbool.h>

void SystemClock_Config(void);
static void MX_GPIO_Init(void);
/* USER CODE BEGIN PFP */
void USER_RCC_Init(void);
void USER_GPIO_Init(void);

void USER_TIM2_Capture_Init(void);
uint16_t USER_TIM2_Capture_Event(void);
void USER_TIM3_Capture_Init(void);
uint16_t USER_TIM3_Capture_Event(void);

void USER_USART3_Init(void);
void USER_USART3_Transmit(uint8_t *pData, uint16_t size);
uint32_t USER_USART3_Receive(void);

void USER_ADC_Init(void);
void USER_ADC_Calibration(void);
uint16_t USER_ADC_Read( void );
/* USER CODE END PFP */

int main(void)
{
  /* USER CODE BEGIN 1 */
  uint16_t event_val1, event_val2, event_diff;
  uint32_t a=0, a1=0, a2=0, b=0, c=0, d=0, t_a=0, t_b=0;
  float pressed_t, freq, max_freq = 0, t=0;
  bool send = false;
  uint16_t dataADC;
  float v;

  uint16_t count = 0, row = 1, tecla, found, changed = 0;
  char msg1[] = "Inicio monitoreo";
  char msg2[] = "Fin monitoreo";
  char msg3[] = "F:  .  P: . ";
  char msg4[] = "Flow sensor";
  char msg5[] = "  .  HZ";
  char msg6[] = "Pressure sensor";
  char msg7[] = " .  V";

  /* USER CODE END 1 */

  /* MCU Configuration--------------------------------------------------------*/

  /* Reset of all peripherals, Initializes the Flash interface and the Systick. */
  HAL_Init();

  /* Configure the system clock */
  SystemClock_Config();

  /* Initialize all configured peripherals */
  MX_GPIO_Init();
  /* USER CODE BEGIN 2 */
  USER_RCC_Init();
  USER_GPIO_Init();
  USER_TIM2_Capture_Init();
  USER_TIM3_Capture_Init();
  USER_USART3_Init();
  USER_ADC_Init();
  USER_ADC_Calibration();
  LCD_Init( );//				inicializamos la libreria del LCD
  LCD_Cursor_OFF( );//			cursor visible activo
  LCD_Clear( );//			borra la pantalla
  LCD_Set_Cursor( 1, 0 );//		posiciona cursor en la fila 1 columna 0
  /* USER CODE END 2 */

  /* Infinite loop */
  /* USER CODE BEGIN WHILE */

  ADC1->CR2	|=	 ADC_CR2_ADON;//	starts the conversion
  TIM2->CNT = 230;	//A
  while (1)
  {
	  GPIOB->BSRR = (1 << 16) | (1 << 1) | (1 << 2) | (1 << 3);
	  found = 0;
	  if(!(GPIOB->IDR & GPIO_IDR_IDR4 ) & !found){
		 tecla = 0x1;
		 found = 1;
	  }
	  if(!(GPIOB->IDR & GPIO_IDR_IDR5 ) & !found){
		  tecla = 0x2;
		  found = 1;
	  }
	  if(!(GPIOB->IDR & GPIO_IDR_IDR6 ) & !found){
		  tecla = 0x3;
		  found = 1;
	  }
	  if(!(GPIOB->IDR & GPIO_IDR_IDR7 ) & !found){
		  tecla = 0xA;
		  found = 1;
	  }

	  GPIOB->BSRR = (1 << 0) | (1 << 17) | (1 << 2) | (1 << 3);
	  if(!(GPIOB->IDR & GPIO_IDR_IDR4 ) & !found){
		  tecla = 0x4;
		  found = 1;
	  }
	  if(!(GPIOB->IDR & GPIO_IDR_IDR5 ) & !found){
		  tecla = 0x5;
		  found = 1;
	  }
	  if(!(GPIOB->IDR & GPIO_IDR_IDR6 ) & !found){
		  tecla = 0x6;
		  found = 1;
	  }
	  if(!(GPIOB->IDR & GPIO_IDR_IDR7 ) & !found){
		  tecla = 0xB;
		  found = 1;
	  }

	  GPIOB->BSRR = (1 << 0) | (1 << 1) | (1 << 18) | (1 << 3);
	  if(!(GPIOB->IDR & GPIO_IDR_IDR4 ) & !found){
		  tecla = 0x7;
		  found = 1;
	  }
	  if(!(GPIOB->IDR & GPIO_IDR_IDR5 ) & !found){
		  tecla = 0x8;
		  found = 1;
	  }
	  if(!(GPIOB->IDR & GPIO_IDR_IDR6 ) & !found){
		  tecla = 0x9;
		  found = 1;
	  }
	  if(!(GPIOB->IDR & GPIO_IDR_IDR7 ) & !found){
		  tecla = 0xC;
		  found = 1;
	  }

	  GPIOB->BSRR = (1 << 0) | (1 << 1) | (1 << 2) | (1 << 19);
	  if(!(GPIOB->IDR & GPIO_IDR_IDR4 ) & !found){
		  tecla = 0xE;
		  found = 1;
	  }
	  if(!(GPIOB->IDR & GPIO_IDR_IDR5 ) & !found){
		  tecla = 0x0;
		  found = 1;
	  }
	  if(!(GPIOB->IDR & GPIO_IDR_IDR6 ) & !found){
		  tecla = 0xF;
		  found = 1;
	  }
	  if(!(GPIOB->IDR & GPIO_IDR_IDR7 ) & !found){
		  tecla = 0xD;
		  found = 1;
	  }

	  //READING CIRCUIT FLOW
	  if(TIM3->SR & TIM_SR_CC1IF){
		  event_val1 = USER_TIM3_Capture_Event();//	capture the 1st event
		  TIM3->CCER ^=	TIM_CCER_CC1P;//		capture is done on different edge

		  event_val2 = USER_TIM3_Capture_Event();//	capture the 2nd event
		  TIM3->CCER ^=	TIM_CCER_CC1P;//		capture is done on different edge

		  event_diff = event_val2 - event_val1;//		2nd event - 1st event
		  //Calculating time according to the timer ticks difference
		  pressed_t = ( 1.0 / 64000000.0 ) * event_diff * (TIM3->PSC + 1);
		  freq = (1/(pressed_t * 2))*3;
		  a = (uint16_t) freq;
		  b = ((uint16_t) (freq * 10)) % 10;

		  a1 = (uint16_t) (a % 10);
		  a2 = (uint16_t) ((a/10) % 10);
		  msg3[2]=a2+'0';
		  msg3[3]=a1+'0';
		  msg3[5]=b+'0';

		  msg5[0]=a2+'0';
		  msg5[1]=a1+'0';
		  msg5[3]=b+'0';
	  }

	  //READING Pressure
	  dataADC = USER_ADC_Read( );
	  v = (float)(dataADC*3.3/4095);
	  c = v;
	  d = ((uint16_t)(v*10))%10;

	  msg3[9]=c+'0';
	  msg3[11]=d+'0';
	  msg7[0]=c+'0';
	  msg7[2]=d+'0';

	  if(TIM2->SR & TIM_SR_UIF){
		  TIM2->SR	&=	!TIM_SR_UIF;
		  TIM2->CR1	&=	 !TIM_CR1_CEN;//		counter disabled
		  t+=0.1;
		  t_a = t;
		  t_b = (t_a*10) % 10;
		  if(send)
			  printf("%d.%d) F: %d.%d || P: %d.%d\n",t_a, t_b,a,b,c,d);
	      //printf("Flow Frequency: %d.%d || Pressure: %d.%d\r\n",a,b,c,d);
	      //USER_USART3_Transmit( msg1, sizeof( msg1 ) );
		  TIM2->CNT = 230;
		  TIM2->CR1	|=	 TIM_CR1_CEN;//		counter enabled
	  }

	  if(found){
		  if(tecla == 0xA){
			  LCD_Clear();
			  LCD_Set_Cursor(1,0);
			  LCD_Put_Str(msg1);
			  send = true;
		  } else if(tecla == 0xB){
			  LCD_Clear();
			  LCD_Set_Cursor(1,0);
			  LCD_Put_Str(msg2);
			  send = false;
		  } else if(tecla == 0xC){
			  LCD_Clear();
			  LCD_Set_Cursor(1,0);
			  LCD_Put_Str(msg4);
		  } else if(tecla == 0xD){
			  LCD_Clear();
			  LCD_Set_Cursor(1,0);
			  LCD_Put_Str(msg6);
		  }
	  }

	  if(tecla == 0xA){
		  LCD_Set_Cursor(2,0);
		  LCD_Put_Str(msg3);
	  } else if(tecla == 0xB){
		  LCD_Set_Cursor(2,0);
		  LCD_Put_Str(msg3);
	  } else if(tecla == 0xC){
		  LCD_Set_Cursor(2,0);
		  LCD_Put_Str(msg5);
	  } else if(tecla == 0xD){
		  LCD_Set_Cursor(2,0);
		  LCD_Put_Str(msg7);
	  }
	  //HAL_Delay(100);

    /* USER CODE END WHILE */

  }
}

void SystemClock_Config(void)
{
  RCC_OscInitTypeDef RCC_OscInitStruct = {0};
  RCC_ClkInitTypeDef RCC_ClkInitStruct = {0};

  /** Initializes the RCC Oscillators according to the specified parameters
  * in the RCC_OscInitTypeDef structure.
  */
  RCC_OscInitStruct.OscillatorType = RCC_OSCILLATORTYPE_HSI;
  RCC_OscInitStruct.HSIState = RCC_HSI_ON;
  RCC_OscInitStruct.HSICalibrationValue = RCC_HSICALIBRATION_DEFAULT;
  RCC_OscInitStruct.PLL.PLLState = RCC_PLL_ON;
  RCC_OscInitStruct.PLL.PLLSource = RCC_PLLSOURCE_HSI_DIV2;
  RCC_OscInitStruct.PLL.PLLMUL = RCC_PLL_MUL16;
  if (HAL_RCC_OscConfig(&RCC_OscInitStruct) != HAL_OK)
  {
    Error_Handler();
  }

  /** Initializes the CPU, AHB and APB buses clocks
  */
  RCC_ClkInitStruct.ClockType = RCC_CLOCKTYPE_HCLK|RCC_CLOCKTYPE_SYSCLK
                              |RCC_CLOCKTYPE_PCLK1|RCC_CLOCKTYPE_PCLK2;
  RCC_ClkInitStruct.SYSCLKSource = RCC_SYSCLKSOURCE_PLLCLK;
  RCC_ClkInitStruct.AHBCLKDivider = RCC_SYSCLK_DIV1;
  RCC_ClkInitStruct.APB1CLKDivider = RCC_HCLK_DIV2;
  RCC_ClkInitStruct.APB2CLKDivider = RCC_HCLK_DIV1;

  if (HAL_RCC_ClockConfig(&RCC_ClkInitStruct, FLASH_LATENCY_2) != HAL_OK)
  {
	Error_Handler();
  }
}

static void MX_GPIO_Init(void)
{

  /* GPIO Ports Clock Enable */
  __HAL_RCC_GPIOC_CLK_ENABLE();
  __HAL_RCC_GPIOD_CLK_ENABLE();
  __HAL_RCC_GPIOA_CLK_ENABLE();
  __HAL_RCC_GPIOB_CLK_ENABLE();

}

/* USER CODE BEGIN 4 */
void USER_RCC_Init(void){
	//I/O port A clock enable
	RCC->APB2ENR	|=	 RCC_APB2ENR_IOPAEN
  					|	 RCC_APB2ENR_ADC1EN;//	ADC 1 clock enable

	RCC->CFGR	|=	 RCC_CFGR_ADCPRE;//	ADC prescaler 1:8 for 8 MHz

	RCC->APB1ENR	|=	 RCC_APB1ENR_TIM2EN//Timer 2 clock enable
					|	 RCC_APB1ENR_TIM3EN//Timer 3 clock enable
					|	 RCC_APB1ENR_USART3EN;//  	USART3 clock enable

}
void USER_GPIO_Init(void){
	//PA0 (TIM2_CH1) as input floating
	GPIOA->CRL	&=	~GPIO_CRL_CNF0_1 & ~GPIO_CRL_MODE0; //Transmit timer
	GPIOA->CRL	|=	 GPIO_CRL_CNF0_0;

	//PA1 (button) as input pull-up
	GPIOA->CRL &= ~GPIO_CRL_CNF1_0 & ~GPIO_CRL_MODE1;
	GPIOA->CRL |= GPIO_CRL_CNF1_1;

	//PA4 (ADC12_IN4) as analog
	GPIOA->CRL	&=	~GPIO_CRL_CNF4 & ~GPIO_CRL_MODE4; //Pressure Sensor

	//pin PA5 (LED) as output push-pull
	GPIOA->CRL &= ~GPIO_CRL_CNF5 & ~GPIO_CRL_MODE5_1;
	GPIOA->CRL |= GPIO_CRL_MODE5_0;

	//PA6 (TIM3_CH1) as input floating
	GPIOA->CRL	&=	~GPIO_CRL_CNF6_1 & ~GPIO_CRL_MODE6; //Flow Sensor
	GPIOA->CRL	|=	 GPIO_CRL_CNF6_0;

	//TECLADO MATRICIAL
	GPIOB->BSRR &= GPIO_BSRR_BR0 & GPIO_BSRR_BR1 & GPIO_BSRR_BR2 & GPIO_BSRR_BR3;
		//pins PB0-PB3 as output push-pull
		GPIOB->CRL &= ~GPIO_CRL_CNF0 & ~GPIO_CRL_MODE0_1;
		GPIOB->CRL |= GPIO_CRL_MODE0_0;
		GPIOB->CRL &= ~GPIO_CRL_CNF1 & ~GPIO_CRL_MODE1_1;
		GPIOB->CRL |= GPIO_CRL_MODE1_0;
		GPIOB->CRL &= ~GPIO_CRL_CNF2 & ~GPIO_CRL_MODE2_1;
		GPIOB->CRL |= GPIO_CRL_MODE2_0;
		GPIOB->CRL &= ~GPIO_CRL_CNF3 & ~GPIO_CRL_MODE3_1;
		GPIOB->CRL |= GPIO_CRL_MODE3_0;

		//pins PB4-PB7 as input pull-up
		GPIOB->CRL &= ~GPIO_CRL_CNF4_0 & ~GPIO_CRL_MODE4;
		GPIOB->CRL |= GPIO_CRL_CNF4_1;
		GPIOB->ODR |= GPIO_ODR_ODR4;
		GPIOB->CRL &= ~GPIO_CRL_CNF5_0 & ~GPIO_CRL_MODE5;
		GPIOB->CRL |= GPIO_CRL_CNF5_1;
		GPIOB->ODR |= GPIO_ODR_ODR5;
		GPIOB->CRL &= ~GPIO_CRL_CNF6_0 & ~GPIO_CRL_MODE6;
		GPIOB->CRL |= GPIO_CRL_CNF6_1;
		GPIOB->ODR |= GPIO_ODR_ODR6;
		GPIOB->CRL &= ~GPIO_CRL_CNF7_0 & ~GPIO_CRL_MODE7;
		GPIOB->CRL |= GPIO_CRL_CNF7_1;
		GPIOB->ODR |= GPIO_ODR_ODR7;

	//pin PB10 (USART3_TX) as alternate function output push-pull, max speed 10MHz
	GPIOB->CRH	&=	~GPIO_CRH_CNF10_0 & ~GPIO_CRH_MODE10_1;
	GPIOB->CRH	|=	 GPIO_CRH_CNF10_1 | GPIO_CRH_MODE10_0; //UART TX

	//pin PB11 (USART3_RX) as input pull-up
	GPIOB->CRH	&=	~GPIO_CRH_CNF11_0 & ~GPIO_CRH_MODE11; //UART RX
	GPIOB->CRH	|=	 GPIO_CRH_CNF11_1;

}

void USER_TIM2_Capture_Init(void){
	TIM2->CR1	&=	~TIM_CR1_CKD_0;
	TIM2->CR1	|=	 TIM_CR1_CKD_1;//	sampling (DTS) = TIM_CLK/4
	TIM2->CCMR1 	&=	~TIM_CCMR1_CC1S_1;
	TIM2->CCMR1 	|=	 TIM_CCMR1_CC1S_0;//	CC1 channel as input, mapped on TI1
	TIM2->CCMR1 	|=	 TIM_CCMR1_IC1F;//	filter -> DTS/32, N=8
	TIM2->CCER	|=	 TIM_CCER_CC1P;//	capture is done on falling edge
	TIM2->CCMR1 	&=	~TIM_CCMR1_IC1PSC;//	no prescaler
	TIM2->CCER	|=	 TIM_CCER_CC1E;//	capture enabled
	TIM2->PSC	 =	 97;//		maximum prescaler
	TIM2->SMCR	&=	!TIM_SMCR_SMS;
	TIM2->CR1	&=	!TIM_CR1_CMS & !TIM_CR1_DIR & !TIM_CR1_UDIS;
	TIM2->SR	&=	!TIM_SR_UIF;
	TIM2->CR1	|=	 TIM_CR1_CEN;//		counter enabled
}
uint16_t USER_TIM2_Capture_Event(void){
	while( !(TIM2->SR & TIM_SR_CC1IF) );//		wait until a capture occurs
	return TIM2->CCR1;//				return the captured value
}

void USER_TIM3_Capture_Init(void){
	TIM3->CR1	&=	~TIM_CR1_CKD_0;
	TIM3->CR1	|=	 TIM_CR1_CKD_1;//	sampling (DTS) = TIM_CLK/4
	TIM3->CCMR1 	&=	~TIM_CCMR1_CC1S_1;
	TIM3->CCMR1 	|=	 TIM_CCMR1_CC1S_0;//	CC1 channel as input, mapped on TI1
	TIM3->CCMR1 	|=	 TIM_CCMR1_IC1F;//	filter -> DTS/32, N=8
	TIM3->CCER	|=	 TIM_CCER_CC1P;//	capture is done on falling edge
	TIM3->CCMR1 	&=	~TIM_CCMR1_IC1PSC;//	no prescaler
	TIM3->CCER	|=	 TIM_CCER_CC1E;//	capture enabled
	TIM3->PSC	 =	 97;//		maximum prescaler

	TIM3->CR1	|=	 TIM_CR1_CEN;//		counter enabled
}

uint16_t USER_TIM3_Capture_Event(void){
	while( !(TIM3->SR & TIM_SR_CC1IF) );//		wait until a capture occurs
	return TIM3->CCR1;//				return the captured value
}

void USER_USART3_Init(void){
	USART3->CR1	|=	 USART_CR1_UE;//		USART enabled
	USART3->CR1	&=	~USART_CR1_M//		  	1 start bit, 8 data bits
			&	~USART_CR1_PCE;//		parity control disabled
	USART3->CR2	&=	~USART_CR2_STOP;//  		1 stop bit
	USART3->BRR	 =	 0xD05;//			9600 bps -> 208.33,
	//USARTDIV = 32*10^6/(16*9600)
	//NEW USARTDIV = 32*10^6/(16*115200)=17.361
	//BRR = [17->HEX=11][.361*16->HEX=6]=116
	//`->BRR = 0x116;

	USART3->CR1	|=	 USART_CR1_TE;//		        transmitter enabled
	USART3->CR1	|=	 USART_CR1_RE;//		        receiver enabled
}

void USER_USART3_Transmit(uint8_t *pData, uint16_t size ){
	for( int i = 0; i < size; i++ ){
		while( ( USART3->SR & USART_SR_TXE ) == 0 ){}//	wait until transmit reg is empty
		USART3->DR = *pData++;//			transmit data
	}
}

uint32_t USER_USART3_Receive(void){
	while((USART3->SR & USART_SR_RXNE) == 0){}
	return USART3->DR;
}

void USER_ADC_Init(void){
	ADC1->CR1	&=	~ADC_CR1_DUALMOD;//	independent mode
	ADC1->CR2	&=	~ADC_CR2_ALIGN;//	right alignment for the result
	ADC1->CR2	|=	 ADC_CR2_CONT;//	continuous conversion mode
	ADC1->SMPR2	&=	~ADC_SMPR2_SMP0;//	1.5 cycles channel sample time
	ADC1->SQR1	&=	~ADC_SQR1_L;//		1 conversion on regular channels
	ADC1->SQR3 	&=	~ADC_SQR3_SQ1;//	first and only conversion in Ch0
	ADC1->SQR3	|=	ADC_SQR3_SQ1_2;
	ADC1->CR2	|=	 ADC_CR2_ADON;//	ADC enabled
	HAL_Delay(1);//					tstab(1us) after ADC enabled, real 1ms
}
void USER_ADC_Calibration(void){
	ADC1->CR2	|=	 ADC_CR2_CAL;//		start calibration
	while( ADC1->CR2 & ADC_CR2_CAL );//		wait until calibration is done
}
uint16_t USER_ADC_Read( void ){
	while( !( ADC1->SR & ADC_SR_EOC ) );//		wait until conversion is done
	return (uint16_t)ADC1->DR;//			return ADC data
}

/* USER CODE END 4 */

/**
  * @brief  This function is executed in case of erropr occurrence.
  * @retval None
  */
void Error_Handler(void)
{
  __disable_irq();
  while (1)
  {
  }
}
