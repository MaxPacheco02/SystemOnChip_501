# file: stm32HelloWorldBlink.ioc
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Mcu.Family=STM32F1
Mcu.Name=STM32F103R(8-B)Tx
Mcu.Package=LQFP64
NVIC.PriorityGroup=NVIC_PRIORITYGROUP_4
PA13.GPIO_Label=TMS
PA13.Mode=Serial_Wire
PA13.Signal=SYS_JTMS-SWDIO
PA14.GPIO_Label=TCK
PA14.Mode=Serial_Wire
PA14.Signal=SYS_JTCK-SWCLK
PB3.GPIO_Label=SWO
PB3.Signal=SYS_JTDO-TRACESWO
PC14-OSC32_IN.Mode=LSE-External-Oscillator
PC14-OSC32_IN.Signal=RCC_OSC32_IN
PC15-OSC32_OUT.Mode=LSE-External-Oscillator
PC15-OSC32_OUT.Signal=RCC_OSC32_OUT
PD0-OSC_IN.Mode=HSE-External-Clock-Source
PD0-OSC_IN.Signal=RCC_OSC_IN
PD1-OSC_OUT.Mode=HSE-External-Clock-Source
PD1-OSC_OUT.Signal=RCC_OSC_OUT
ProjectManager.HeapSize=0x200
ProjectManager.StackSize=0x400
ProjectManager.TargetToolchain=STM32CubeIDE
RCC.AHBFreq_Value=64000000
RCC.APB1CLKDivider=RCC_HCLK_DIV2
RCC.APB1Freq_Value=32000000
RCC.APB1TimFreq_Value=64000000
RCC.APB2Freq_Value=64000000
RCC.APB2TimFreq_Value=64000000
RCC.HCLKFreq_Value=64000000
RCC.PLLMUL=RCC_PLL_MUL16
RCC.RTCClockSelection=RCC_RTCCLKSOURCE_LSE
RCC.SYSCLKFreq_VALUE=64000000
RCC.SYSCLKSource=RCC_SYSCLKSOURCE_PLLCLK
RCC.USBFreq_Value=64000000
board=NUCLEO-F103RB

// file: Core/Src/main.c
/* USER CODE BEGIN Header */
/**
  ******************************************************************************
  * @file           : main.c
  * @author         : rahu7p
  ******************************************************************************
  * @board			: nucleo-f103rb
  * @mcu			: stm32f103rb
  *
  *
  *
  * This code programs a blinking LED (LD2): on-and-off every second.
  *
  *
  *
  ******************************************************************************
  */
/* USER CODE END Header */
#include "main.h"
#include "lcd.h"

void SystemClock_Config(void);
static void MX_GPIO_Init(void);
/* USER CODE BEGIN PFP */
void USER_RCC_Init(void);
void USER_GPIO_Init(void);
/* USER CODE END PFP */

int main(void)
{

  /* MCU Configuration--------------------------------------------------------*/

  /* Reset of all peripherals, Initializes the Flash interface and the Systick. */
  HAL_Init();

  /* Configure the system clock */
  SystemClock_Config();

  /* Initialize all configured peripherals */
  MX_GPIO_Init();
  /* USER CODE BEGIN 2 */
  USER_RCC_Init();
  USER_GPIO_Init();
  //LCD_Init( );//				inicializamos la libreria del LCD
  //LCD_Cursor_ON( );//			cursor visible activo
  //LCD_Clear( );//			borra la pantalla
  //LCD_Set_Cursor( 1, 0 );//		posiciona cursor en la fila 1 columna 0
  //LCD_Put_Str( "ABCDEFGHIJKLMNOd" );//	escribe un string
  //LCD_Set_Cursor(2,0);
  //LCD_Put_Str( "ABC" );//	escribe un string

  uint16_t count = 0, row = 1, tecla, found, changed = 0;

  char msg[31], msg1[16], msg2[16];
  char key[] = "0123456789ABCD ";

  for(int i = 0; i < 31 ; i++){
	  msg[i] = 0x0;
  }
  /* USER CODE END 2 */

  /* Infinite loop */
  /* USER CODE BEGIN WHILE */
  while (1)
  {
//A
		GPIOA->BSRR = GPIO_BSRR_BR13;
		GPIOA->BSRR = GPIO_BSRR_BR1;
		GPIOA->BSRR = GPIO_BSRR_BR15;

		HAL_Delay(1000);//			1 second delay

		GPIOA->BSRR = GPIO_BSRR_BS13;
		GPIOA->BSRR = GPIO_BSRR_BS1;
		GPIOA->BSRR = GPIO_BSRR_BR15;

		HAL_Delay(1000);//			1 second delay

		GPIOA->BSRR = GPIO_BSRR_BR13;
		GPIOA->BSRR = GPIO_BSRR_BR1;
		GPIOA->BSRR = GPIO_BSRR_BS15;

		HAL_Delay(1000);//			1 second delay

		/*
	  GPIOA->BSRR = GPIO_BSRR_BS15;//	LD2 ON
	  HAL_Delay(1000);//			1 second delay
	  GPIOA->BSRR = GPIO_BSRR_BR15;//	LD2 OFF
	  HAL_Delay(1000);//			1 second delay
	  */

//B
/*
	  //Bouncing
	  if(!(GPIOA->IDR & GPIO_IDR_IDR10)){
		  GPIOA->ODR ^= GPIO_ODR_ODR5;
	  }
*/
/*
	  //Debounced, pull-up interno
	  if(!(GPIOA->IDR & GPIO_IDR_IDR10)){
		  GPIOA->ODR ^= GPIO_ODR_ODR5;
		  while(!(GPIOA->IDR & GPIO_IDR_IDR10)){}
		  HAL_Delay(10);
	  }
*/

//C
	  /*
	  GPIOB->BSRR = (1 << 16) | (1 << 1) | (1 << 2) | (1 << 3);
	  found = 0;
	  if(!(GPIOB->IDR & GPIO_IDR_IDR4 ) & !found){
		 tecla = 0x1;
		 found = 1;
	  }
	  if(!(GPIOB->IDR & GPIO_IDR_IDR5 ) & !found){
		  tecla = 0x2;
		  found = 1;
	  }
	  if(!(GPIOB->IDR & GPIO_IDR_IDR6 ) & !found){
		  tecla = 0x3;
		  found = 1;
	  }
	  if(!(GPIOB->IDR & GPIO_IDR_IDR7 ) & !found){
		  tecla = 0xA;
		  found = 1;
	  }

	  GPIOB->BSRR = (1 << 0) | (1 << 17) | (1 << 2) | (1 << 3);
	  if(!(GPIOB->IDR & GPIO_IDR_IDR4 ) & !found){
		  tecla = 0x4;
		  found = 1;
	  }
	  if(!(GPIOB->IDR & GPIO_IDR_IDR5 ) & !found){
		  tecla = 0x5;
		  found = 1;
	  }
	  if(!(GPIOB->IDR & GPIO_IDR_IDR6 ) & !found){
		  tecla = 0x6;
		  found = 1;
	  }
	  if(!(GPIOB->IDR & GPIO_IDR_IDR7 ) & !found){
		  tecla = 0xB;
		  found = 1;
	  }

	  GPIOB->BSRR = (1 << 0) | (1 << 1) | (1 << 18) | (1 << 3);
	  if(!(GPIOB->IDR & GPIO_IDR_IDR4 ) & !found){
		  tecla = 0x7;
		  found = 1;
	  }
	  if(!(GPIOB->IDR & GPIO_IDR_IDR5 ) & !found){
		  tecla = 0x8;
		  found = 1;
	  }
	  if(!(GPIOB->IDR & GPIO_IDR_IDR6 ) & !found){
		  tecla = 0x9;
		  found = 1;
	  }
	  if(!(GPIOB->IDR & GPIO_IDR_IDR7 ) & !found){
		  tecla = 0xC;
		  found = 1;
	  }

	  GPIOB->BSRR = (1 << 0) | (1 << 1) | (1 << 2) | (1 << 19);
	  if(!(GPIOB->IDR & GPIO_IDR_IDR4 ) & !found){
		  tecla = 0xE;
		  found = 1;
	  }
	  if(!(GPIOB->IDR & GPIO_IDR_IDR5 ) & !found){
		  tecla = 0x0;
		  found = 1;
	  }
	  if(!(GPIOB->IDR & GPIO_IDR_IDR6 ) & !found){
		  tecla = 0xF;
		  found = 1;
	  }
	  if(!(GPIOB->IDR & GPIO_IDR_IDR7 ) & !found){
		  tecla = 0xD;
		  found = 1;
	  }

	  if(!found)
		  tecla = 0x10;

	  if(found){
		  changed = 1;
		  if(tecla == 0xE){
			  if(count > 0){
				  msg[count-1] = 0x0;
				  count--;

				  if(count>=16)
					  msg2[count%16] = 0x0;
				  else
					  msg1[count] = 0x0;
			  }
		  } else if(count <= 31){
			  if(tecla == 0xF)
				  msg[count] = key[0xE];
			  else
				  msg[count] = key[tecla];
			  count++;
		  }
	  }

	  for(int i = 0 ; i < 16 ; i++){
		  msg1[i] = msg[i];
		  msg2[i] = msg[i+16];
	  }

	  if(changed == 1){
		  changed = 0;
		  LCD_Clear();

		  LCD_Set_Cursor(1,0);
		  LCD_Put_Str(msg1);
		  LCD_Set_Cursor(2,0);
		  LCD_Put_Str(msg2);
		  LCD_Set_Cursor(count/16 + 1, (count+1) % 17);
	  }

	  HAL_Delay(50);
	  */

    /* USER CODE END WHILE */

  }
}

void SystemClock_Config(void)
{
  RCC_OscInitTypeDef RCC_OscInitStruct = {0};
  RCC_ClkInitTypeDef RCC_ClkInitStruct = {0};

  /** Initializes the RCC Oscillators according to the specified parameters
  * in the RCC_OscInitTypeDef structure.
  */
  RCC_OscInitStruct.OscillatorType = RCC_OSCILLATORTYPE_HSI;
  RCC_OscInitStruct.HSIState = RCC_HSI_ON;
  RCC_OscInitStruct.HSICalibrationValue = RCC_HSICALIBRATION_DEFAULT;
  RCC_OscInitStruct.PLL.PLLState = RCC_PLL_ON;
  RCC_OscInitStruct.PLL.PLLSource = RCC_PLLSOURCE_HSI_DIV2;
  RCC_OscInitStruct.PLL.PLLMUL = RCC_PLL_MUL16;
  if (HAL_RCC_OscConfig(&RCC_OscInitStruct) != HAL_OK)
  {
    Error_Handler();
  }

  /** Initializes the CPU, AHB and APB buses clocks
  */
  RCC_ClkInitStruct.ClockType = RCC_CLOCKTYPE_HCLK|RCC_CLOCKTYPE_SYSCLK
                              |RCC_CLOCKTYPE_PCLK1|RCC_CLOCKTYPE_PCLK2;
  RCC_ClkInitStruct.SYSCLKSource = RCC_SYSCLKSOURCE_PLLCLK;
  RCC_ClkInitStruct.AHBCLKDivider = RCC_SYSCLK_DIV1;
  RCC_ClkInitStruct.APB1CLKDivider = RCC_HCLK_DIV2;
  RCC_ClkInitStruct.APB2CLKDivider = RCC_HCLK_DIV1;

  if (HAL_RCC_ClockConfig(&RCC_ClkInitStruct, FLASH_LATENCY_2) != HAL_OK)
  {
    Error_Handler();
  }
}

static void MX_GPIO_Init(void)
{

  /* GPIO Ports Clock Enable */
  __HAL_RCC_GPIOC_CLK_ENABLE();
  __HAL_RCC_GPIOD_CLK_ENABLE();
  __HAL_RCC_GPIOA_CLK_ENABLE();
  __HAL_RCC_GPIOB_CLK_ENABLE();

}

/* USER CODE BEGIN 4 */
void USER_RCC_Init(void){
	RCC->APB2ENR |= RCC_APB2ENR_IOPAEN;//		I/O port A clock enable
}

void USER_GPIO_Init(void){
//A, B

	//LED
	GPIOA->BSRR = GPIO_BSRR_BR5;//			PA5 -> 0, LD2 OFF
	//pin A5 as output push-pull max speed 10MHz
	GPIOA->CRL &= ~GPIO_CRL_CNF5 & ~GPIO_CRL_MODE5_1;
	GPIOA->CRL |= GPIO_CRL_MODE5_0;

	/*
	//Bouncing and debounced
	//pin PA10 as input floating
	GPIOA->CRH &= ~GPIO_CRH_MODE10 & ~GPIO_CRH_CNF10_1;
	GPIOA->CRH |= GPIO_CRH_CNF10_0;
	*/

	/*
	//Pull-up interno
	//pin PA10 as input pull-up
	GPIOA->CRH &= ~GPIO_CRH_MODE10 & ~GPIO_CRH_CNF10_0;
	GPIOA->CRH |= GPIO_CRH_CNF10_1;
	GPIOA->ODR |= GPIO_ODR_ODR10;
	*/

//C

	//pin PA13 (Relay Valve Out) as output push-pull
	GPIOA->CRH &= ~GPIO_CRH_CNF13 & ~GPIO_CRH_MODE13_1;
	GPIOA->CRH |= GPIO_CRH_MODE13_0;

	//pin PA1 (Relay Valve Out) as output push-pull
	GPIOA->CRL &= ~GPIO_CRL_CNF1 & ~GPIO_CRL_MODE1_1;
	GPIOA->CRL |= GPIO_CRL_MODE1_0;

	//pin PA15 (Relay Valve Out) as output push-pull
	GPIOA->CRH &= ~GPIO_CRH_CNF15 & ~GPIO_CRH_MODE15_1;
	GPIOA->CRH |= GPIO_CRH_MODE15_0;

	GPIOB->BSRR &= GPIO_BSRR_BR0 & GPIO_BSRR_BR1 & GPIO_BSRR_BR2 & GPIO_BSRR_BR3;
	//pins PB0-PB3 as output push-pull
	GPIOB->CRL &= ~GPIO_CRL_CNF0 & ~GPIO_CRL_MODE0_1;
	GPIOB->CRL |= GPIO_CRL_MODE0_0;
	GPIOB->CRL &= ~GPIO_CRL_CNF1 & ~GPIO_CRL_MODE1_1;
	GPIOB->CRL |= GPIO_CRL_MODE1_0;
	GPIOB->CRL &= ~GPIO_CRL_CNF2 & ~GPIO_CRL_MODE2_1;
	GPIOB->CRL |= GPIO_CRL_MODE2_0;
	GPIOB->CRL &= ~GPIO_CRL_CNF3 & ~GPIO_CRL_MODE3_1;
	GPIOB->CRL |= GPIO_CRL_MODE3_0;

	//pins PB4-PB7 as input pull-up
	GPIOB->CRL &= ~GPIO_CRL_CNF4_0 & ~GPIO_CRL_MODE4;
	GPIOB->CRL |= GPIO_CRL_CNF4_1;
	GPIOB->ODR |= GPIO_ODR_ODR4;
	GPIOB->CRL &= ~GPIO_CRL_CNF5_0 & ~GPIO_CRL_MODE5;
	GPIOB->CRL |= GPIO_CRL_CNF5_1;
	GPIOB->ODR |= GPIO_ODR_ODR5;
	GPIOB->CRL &= ~GPIO_CRL_CNF6_0 & ~GPIO_CRL_MODE6;
	GPIOB->CRL |= GPIO_CRL_CNF6_1;
	GPIOB->ODR |= GPIO_ODR_ODR6;
	GPIOB->CRL &= ~GPIO_CRL_CNF7_0 & ~GPIO_CRL_MODE7;
	GPIOB->CRL |= GPIO_CRL_CNF7_1;
	GPIOB->ODR |= GPIO_ODR_ODR7;

}
/* USER CODE END 4 */

void Error_Handler(void)
{
  __disable_irq();
  while (1)
  {
  }
}
