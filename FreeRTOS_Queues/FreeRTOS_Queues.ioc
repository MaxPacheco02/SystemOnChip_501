# file: FreeRTOS_Queues.ioc
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FREERTOS.Tasks01=defaultTask,-3,128,StartDefaultTask,Default,NULL,Dynamic,NULL,NULL
FREERTOS.configUSE_NEWLIB_REENTRANT=1
Mcu.Family=STM32F1
Mcu.Name=STM32F103R(8-B)Tx
Mcu.Package=LQFP64
NVIC.PriorityGroup=NVIC_PRIORITYGROUP_4
NVIC.TIM4_IRQn=true\:15\:0\:false\:false\:true\:false\:false\:true\:true
NVIC.TimeBase=TIM4_IRQn
NVIC.TimeBaseIP=TIM4
PA13.GPIO_Label=TMS
PA13.Mode=Serial_Wire
PA13.Signal=SYS_JTMS-SWDIO
PA14.GPIO_Label=TCK
PA14.Mode=Serial_Wire
PA14.Signal=SYS_JTCK-SWCLK
PB3.GPIO_Label=SWO
PB3.Signal=SYS_JTDO-TRACESWO
PC14-OSC32_IN.Mode=LSE-External-Oscillator
PC14-OSC32_IN.Signal=RCC_OSC32_IN
PC15-OSC32_OUT.Mode=LSE-External-Oscillator
PC15-OSC32_OUT.Signal=RCC_OSC32_OUT
PD0-OSC_IN.Mode=HSE-External-Clock-Source
PD0-OSC_IN.Signal=RCC_OSC_IN
PD1-OSC_OUT.Mode=HSE-External-Clock-Source
PD1-OSC_OUT.Signal=RCC_OSC_OUT
ProjectManager.HeapSize=0x200
ProjectManager.StackSize=0x400
ProjectManager.TargetToolchain=STM32CubeIDE
RCC.AHBFreq_Value=64000000
RCC.APB1CLKDivider=RCC_HCLK_DIV2
RCC.APB1Freq_Value=32000000
RCC.APB1TimFreq_Value=64000000
RCC.APB2Freq_Value=64000000
RCC.APB2TimFreq_Value=64000000
RCC.HCLKFreq_Value=64000000
RCC.PLLMUL=RCC_PLL_MUL16
RCC.RTCClockSelection=RCC_RTCCLKSOURCE_LSE
RCC.SYSCLKFreq_VALUE=64000000
RCC.SYSCLKSource=RCC_SYSCLKSOURCE_PLLCLK
RCC.USBFreq_Value=64000000
VP_FREERTOS_VS_CMSIS_V1.Mode=CMSIS_V1
VP_SYS_VS_tim4.Mode=TIM4
board=NUCLEO-F103RB

// file: Core/Src/main.c
/* USER CODE BEGIN Header */
/**
  ******************************************************************************
  * @file           : main.c
  * @author         : rahu7p
  ******************************************************************************
  * @board	: nucleo-f103rb
  * @mcu	: stm32f103rb
  * @api      	: CMSIS-RTOSv1
  *
  *
  * This code creates two tasks with same priority: a sender and a receiver task.
  * The sender task puts a message into a Queue object every one second, and the
  * receiver task gets the message.
  *
  ******************************************************************************
  */
/* USER CODE END Header */
#include "main.h"
#include "myprintf.h"
#include "cmsis_os.h"

osThreadId defaultTaskHandle;
/* USER CODE BEGIN PV */
osThreadId sTaskHandle;
osThreadId rTaskHandle;
osMessageQId msgQueueHandle;

uint16_t count = 0, row = 1, changed = 0;
uint16_t key_change_template[] = {0,1,2,3};
uint16_t key_change[] = {0,1,2,3};
uint16_t keys[] = {0x1, 0x2, 0x3, 0xA, 0x4, 0x5, 0x6, 0xB, 0x7, 0x8, 0x9, 0xC, 0xE, 0x0, 0xF, 0xD};
char msg[5][6] = {{"up"},{"left"},{"right"},{"down"},{""}};

/* USER CODE END PV */

void SystemClock_Config(void);
static void MX_GPIO_Init(void);
void StartDefaultTask(void const * argument);

/* USER CODE BEGIN PFP */
void USER_RCC_Init(void);
void USER_GPIO_Init(void);
void USER_USART2_Init(void);
void USER_USART2_Transmit(uint8_t *pData, uint16_t size);
uint32_t USER_USART2_Receive(void);

void SenderTask(void const * argument);
void ReceiverTask(void const * argument);
/* USER CODE END PFP */

int main(void)
{

  /* MCU Configuration--------------------------------------------------------*/

  /* Reset of all peripherals, Initializes the Flash interface and the Systick. */
  HAL_Init();

  /* Configure the system clock */
  SystemClock_Config();

  /* Initialize all configured peripherals */
  MX_GPIO_Init();
  /* USER CODE BEGIN 2 */
  USER_RCC_Init();
  USER_GPIO_Init();
  USER_USART2_Init();
  /* USER CODE END 2 */

  /* USER CODE BEGIN RTOS_QUEUES */
  osMessageQDef(msgQueue, 1, uint32_t);
  msgQueueHandle = osMessageCreate(osMessageQ(msgQueue), NULL);
  /* USER CODE END RTOS_QUEUES */

  /* Create the thread(s) */
  /* definition and creation of defaultTask */
  osThreadDef(defaultTask, StartDefaultTask, osPriorityIdle, 0, 128);
  defaultTaskHandle = osThreadCreate(osThread(defaultTask), NULL);

  /* USER CODE BEGIN RTOS_THREADS */
  osThreadDef(sTask, SenderTask, osPriorityNormal, 0, 128);
  sTaskHandle = osThreadCreate(osThread(sTask), NULL);
  osThreadDef(rTask, ReceiverTask, osPriorityNormal, 0, 128);
  rTaskHandle = osThreadCreate(osThread(rTask), NULL);
  /* USER CODE END RTOS_THREADS */

  /* Start scheduler */
  printf("\n\n\n\n\n\n\n\n\n\n\n\n\n\n\n\n\n\n\n\r\nStarting...\r\n");
  osKernelStart();
  /* We should never get here as control is now taken by the scheduler */
  /* Infinite loop */
  while (1)
  {

  }
}

void SystemClock_Config(void)
{
  RCC_OscInitTypeDef RCC_OscInitStruct = {0};
  RCC_ClkInitTypeDef RCC_ClkInitStruct = {0};

  /** Initializes the RCC Oscillators according to the specified parameters
  * in the RCC_OscInitTypeDef structure.
  */
  RCC_OscInitStruct.OscillatorType = RCC_OSCILLATORTYPE_HSI;
  RCC_OscInitStruct.HSIState = RCC_HSI_ON;
  RCC_OscInitStruct.HSICalibrationValue = RCC_HSICALIBRATION_DEFAULT;
  RCC_OscInitStruct.PLL.PLLState = RCC_PLL_ON;
  RCC_OscInitStruct.PLL.PLLSource = RCC_PLLSOURCE_HSI_DIV2;
  RCC_OscInitStruct.PLL.PLLMUL = RCC_PLL_MUL16;
  if (HAL_RCC_OscConfig(&RCC_OscInitStruct) != HAL_OK)
  {
    Error_Handler();
  }

  /** Initializes the CPU, AHB and APB buses clocks
  */
  RCC_ClkInitStruct.ClockType = RCC_CLOCKTYPE_HCLK|RCC_CLOCKTYPE_SYSCLK
                              |RCC_CLOCKTYPE_PCLK1|RCC_CLOCKTYPE_PCLK2;
  RCC_ClkInitStruct.SYSCLKSource = RCC_SYSCLKSOURCE_PLLCLK;
  RCC_ClkInitStruct.AHBCLKDivider = RCC_SYSCLK_DIV1;
  RCC_ClkInitStruct.APB1CLKDivider = RCC_HCLK_DIV2;
  RCC_ClkInitStruct.APB2CLKDivider = RCC_HCLK_DIV1;

  if (HAL_RCC_ClockConfig(&RCC_ClkInitStruct, FLASH_LATENCY_2) != HAL_OK)
  {
    Error_Handler();
  }
}

static void MX_GPIO_Init(void)
{

  /* GPIO Ports Clock Enable */
  __HAL_RCC_GPIOA_CLK_ENABLE();
  __HAL_RCC_GPIOB_CLK_ENABLE();

}

/* USER CODE BEGIN 4 */
void USER_RCC_Init(void){
	RCC->APB1ENR	|=	 RCC_APB1ENR_USART2EN;//  	USART2 clock enable
	RCC->APB2ENR	|=	 RCC_APB2ENR_IOPAEN;//    	I/O port A clock enable
}

void USER_GPIO_Init(void){
	GPIOA->BSRR = GPIO_BSRR_BR5;//			PA5 -> 0, LD2 OFF
	//pin PA5 as output push-pull max speed 10MHz
	GPIOA->CRL &= ~GPIO_CRL_CNF5 & ~GPIO_CRL_MODE5_1;
	GPIOA->CRL |= GPIO_CRL_MODE5_0;

	//pin PA2 (USART2_TX) as alternate function output push-pull, max speed 10MHz
	GPIOA->CRL	&=	~GPIO_CRL_CNF2_0 & ~GPIO_CRL_MODE2_1;
	GPIOA->CRL	|=	 GPIO_CRL_CNF2_1 | GPIO_CRL_MODE2_0;

	//pin PA3 (USART_RX) as input pull-up
	GPIOA->CRL	&=	~GPIO_CRL_CNF3_0 & ~GPIO_CRL_MODE3;
	GPIOA->CRL	|=	 GPIO_CRL_CNF3_1;

	GPIOB->BSRR &= GPIO_BSRR_BR0 & GPIO_BSRR_BR1 & GPIO_BSRR_BR2 & GPIO_BSRR_BR3;
	//pins PB0-PB3 as output push-pull
	GPIOB->CRL &= ~GPIO_CRL_CNF0 & ~GPIO_CRL_MODE0_1;
	GPIOB->CRL |= GPIO_CRL_MODE0_0;
	GPIOB->CRL &= ~GPIO_CRL_CNF1 & ~GPIO_CRL_MODE1_1;
	GPIOB->CRL |= GPIO_CRL_MODE1_0;
	GPIOB->CRL &= ~GPIO_CRL_CNF2 & ~GPIO_CRL_MODE2_1;
	GPIOB->CRL |= GPIO_CRL_MODE2_0;
	GPIOB->CRL &= ~GPIO_CRL_CNF3 & ~GPIO_CRL_MODE3_1;
	GPIOB->CRL |= GPIO_CRL_MODE3_0;
	//pins PB4-PB7 as input pull-up
	GPIOB->CRL &= ~GPIO_CRL_CNF4_0 & ~GPIO_CRL_MODE4;
	GPIOB->CRL |= GPIO_CRL_CNF4_1;
	GPIOB->ODR |= GPIO_ODR_ODR4;
	GPIOB->CRL &= ~GPIO_CRL_CNF5_0 & ~GPIO_CRL_MODE5;
	GPIOB->CRL |= GPIO_CRL_CNF5_1;
	GPIOB->ODR |= GPIO_ODR_ODR5;
	GPIOB->CRL &= ~GPIO_CRL_CNF6_0 & ~GPIO_CRL_MODE6;
	GPIOB->CRL |= GPIO_CRL_CNF6_1;
	GPIOB->ODR |= GPIO_ODR_ODR6;
	GPIOB->CRL &= ~GPIO_CRL_CNF7_0 & ~GPIO_CRL_MODE7;
	GPIOB->CRL |= GPIO_CRL_CNF7_1;
	GPIOB->ODR |= GPIO_ODR_ODR7;
}

void USER_USART2_Init(void){
	USART2->CR1	|=	 USART_CR1_UE;//		USART enabled
	USART2->CR1	&=	~USART_CR1_M//		  	1 start bit, 8 data bits
			&	~USART_CR1_PCE;//		parity control disabled
	USART2->CR2	&=	~USART_CR2_STOP;//  		1 stop bit
	USART2->BRR	 =	 0xD05;//			9600 bps -> 208.33,
	//USARTDIV = 32*10^6/(16*9600)
	//NEW USARTDIV = 32*10^6/(16*115200)=17.361
	//BRR = [17->HEX=11][.361*16->HEX=6]=116
	//USART2->BRR = 0x116;
	USART2->CR1	|=	 USART_CR1_TE;//		        transmitter enabled
	USART2->CR1	|=	 USART_CR1_RE;//		        receiver enabled
}

void USER_USART2_Transmit(uint8_t *pData, uint16_t size ){
	for( int i = 0; i < size; i++ ){
		while( ( USART2->SR & USART_SR_TXE ) == 0 ){}//	wait until transmit reg is empty
		USART2->DR = *pData++;//			transmit data
	}
}

uint32_t USER_USART2_Receive(void){
	while((USART2->SR & USART_SR_RXNE) == 0){}
	return USART2->DR;
}

void SenderTask(void const * argument){
	uint32_t choice = 0, counter = 0;
	uint32_t temp, tecla, found;
	for(;;)
	{
		found = 0;
		for(int i = 0 ; i < 4 ; i++){
			for(int j = 0 ; j < 4 ; j++){
				key_change[j] = key_change_template[j];
			}
			key_change[i]+=16;

			GPIOB->BSRR = (1 << key_change[0]) | (1 << key_change[1]) | (1 << key_change[2]) | (1 << key_change[3]);
			if(!(GPIOB->IDR & GPIO_IDR_IDR4 ) & !found){
			 tecla = keys[4*i];
			 found = 1;
			}
			if(!(GPIOB->IDR & GPIO_IDR_IDR5 ) & !found){
			  tecla = keys[1+4*i];
			  found = 1;
			}
			if(!(GPIOB->IDR & GPIO_IDR_IDR6 ) & !found){
			  tecla = keys[2+4*i];
			  found = 1;
			}
			if(!(GPIOB->IDR & GPIO_IDR_IDR7 ) & !found){
			  tecla = keys[3+4*i];
			  found = 1;
			}
		}
		if(found){
			if (tecla == 2 || tecla == 4 || tecla == 8)
				choice = (tecla / 2) - 1;
			else if (tecla == 11)
				choice = 2;
			else
				choice = 4;
		} else
			choice = 4;
		//printf("Send %s\r\n", msg[choice]);
		if( osMessagePut(msgQueueHandle, choice, 0) != osOK )
			printf("Failed to put data to the Queue\r\n");
		temp = osKernelSysTick() - (200 * counter++);
		osDelay( 200 - temp );
	}
}
void ReceiverTask(void const * argument){
	osEvent r_event;
	for(;;)
	{
		r_event = osMessageGet(msgQueueHandle, 200);
		if( r_event.status == osEventMessage ){
			uint32_t choice = r_event.value.v;
			printf("Received: %s\r\n", msg[choice] );
		}
		else
			printf("Failed to get data from the Queue\r\n");
	}
}
/* USER CODE END 4 */

void StartDefaultTask(void const * argument)
{
  for(;;)
  {
	osDelay(1);
  }
}

void HAL_TIM_PeriodElapsedCallback(TIM_HandleTypeDef *htim)
{
  if (htim->Instance == TIM4) {
    HAL_IncTick();
  }
}

void Error_Handler(void)
{
}
